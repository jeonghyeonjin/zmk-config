## config/boards/shields/urchin/Kconfig.defconfig
```kconfig
# Copyright (c) 2022 Duccio Breschi
# SPDX-License-Identifier: MIT

if SHIELD_BISCUIT38_LEFT

config ZMK_KEYBOARD_NAME
    default "biscuit38"

config ZMK_SPLIT_ROLE_CENTRAL
    default y

endif

if SHIELD_BISCUIT38_LEFT || SHIELD_BISCUIT38_RIGHT
config ZMK_SPLIT
    default y
endif
```

## config/boards/shields/urchin/Kconfig.shield
```kconfig
# Copyright (c) 2022 Keebbear
# SPDX-License-Identifier: MIT

config SHIELD_BISCUIT38_LEFT
    def_bool $(shields_list_contains,biscuit38_left)

config SHIELD_BISCUIT38_RIGHT
    def_bool $(shields_list_contains,biscuit38_right)
```

## config/west.yml
```yaml
manifest:
  remotes:
    - name: zmkfirmware
      url-base: https://github.com/Xoffio/
  projects:
    - name: zmk
      remote: zmkfirmware
      revision: xo-status-fx
      import: app/west.yml
  self:
    path: config
```
